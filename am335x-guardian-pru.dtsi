/*
 * Copyright (C) 2015 Texas Instruments Incorporated - http://www.ti.com/
 *
 * This program is free software; you can redistribute it and/or modify
 * it under the terms of the GNU General Public License version 2 as
 * published by the Free Software Foundation.
 */

&am33xx_pinmux {
	pru_cape_bone_pins: pru_cape_bone_pins {
		pinctrl-single,pins = <
			0x1a4 0x2e	/* mcasp0_fsr, OMAP_MUX_MODE6 | AM33XX_PIN_INPUT, PRU CAPE SW1 */
			0x1ac 0x2e	/* mcasp0_ahclkx, OMAP_MUX_MODE6 | AM33XX_PIN_INPUT, PRU CAPE SW2 */
			0x19c 0x05	/* mcasp0_ahclkr, OMAP_MUX_MODE5 | AM33XX_PIN_OUTPUT, PRU CAPE Red LED */
			0x198 0x05	/* mcasp0_axr0, OMAP_MUX_MODE5 | AM33XX_PIN_OUTPUT, PRU CAPE Orange LED */
			0x190 0x05	/* mcasp0_aclkx, OMAP_MUX_MODE5 | AM33XX_PIN_OUTPUT, PRU CAPE Blue LED */
			0x194 0x05	/* mcasp0_fsx, OMAP_MUX_MODE5 | AM33XX_PIN_OUTPUT, PRU CAPE Green LED */
			0x0ac 0x05	/* lcd_data3, OMAP_MUX_MODE5 | AM33XX_PIN_OUTPUT, PRU CAPE RGB_0 LED, HDMI Conf. */
			0x0b0 0x05	/* lcd_data4, OMAP_MUX_MODE5 | AM33XX_PIN_OUTPUT, PRU CAPE RGB_1 LED, HDMI Conf. */
			0x0b4 0x05	/* lcd_data5, OMAP_MUX_MODE5 | AM33XX_PIN_OUTPUT, PRU CAPE RGB_2 LED, HDMI Conf. */
                        AM33XX_IOPAD(0x980, PIN_INPUT | MUX_MODE0) /* (D16) uart1_rxd.uart1_rxd */
                        AM33XX_IOPAD(0x984, PIN_OUTPUT | MUX_MODE0) /* (D15) uart1_txd.uart1_txd */
                        AM33XX_IOPAD(0x978, PIN_OUTPUT | MUX_MODE2) /* (D18) dcan0_tx */
                        AM33XX_IOPAD(0x97c, PIN_INPUT | MUX_MODE2) /* (D17) dcan0_rx */
                        AM33XX_IOPAD(0x880, PIN_OUTPUT | MUX_MODE5) /* (U9) gpmc_csn1.pr1_pru1_pru_r30[12] - AE Signal for Phytec PCM-953 LED1*/
                        AM33XX_IOPAD(0x884, PIN_OUTPUT | MUX_MODE5) /* (V9) gpmc_csn2.pr1_pru1_pru_r30[13] - AE Signal for Phytec PCM-953 LED2*/
                        AM33XX_IOPAD(0x820, PIN_OUTPUT_PULLDOWN | MUX_MODE7) /* (U10) gpmc_ad8.gpio0[22] - AE pulling SFS mode pin down to enable CAN pins output on the MPP-C panel processor card */
                        AM33XX_IOPAD(0x828, PIN_OUTPUT_PULLUP | MUX_MODE7) /* (T11) gpmc_ad10.gpio0[26] - AE pulling BDS mode pin up to enable CAN pins output on the MPP-C panel processor card */
		>;
	};
};

&pruss {
        pinctrl-names = "default";
	pinctrl-0 = <&pru_cape_bone_pins>;
};
